## drivers/bmi/pims/camera/Kconfig
```kconfig
config BMI_CAMERA
	tristate "BMI Camera"
	depends on MACH_BUG
	default n
	---help---
	  This is the BMI Camera driver.

choice
        prompt "Select Camera"
        depends on (BMI_CAMERA)

config BMI_CAMERA_VS6624
        tristate "ST VS6624 camera support"
        ---help---
          If you plan to use the ST VS6624 Camera with your BUG system, say Y here.

config BMI_CAMERA_OV2640
        tristate "Omnivision OV2640 camera support"
        ---help---
          If you plan to use the Omnivision OV2640 Camera with your BUG system, say Y here.
endchoice
```
